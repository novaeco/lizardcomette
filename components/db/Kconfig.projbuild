## components/db/Kconfig.projbuild
```kconfig
config DB_DEFAULT_KEY
    string "Default SQLCipher key"
    default ""
    help
        Default encryption key used for lizard.db when SQLCipher is available.
        Leave empty to input the key manually on first boot.
```

## components/drivers/Kconfig
```kconfig
menu "Driver pin configuration"

config I2C_SDA_GPIO
    int "GPIO for shared I2C SDA"
    default 21
    help
        SDA pin for the common I2C bus used by sensors.

config I2C_SCL_GPIO
    int "GPIO for shared I2C SCL"
    default 22
    help
        SCL pin for the common I2C bus used by sensors.

config CO2_SDA_GPIO
    int "GPIO for CO2 sensor SDA"
    default 21
    help
        SDA pin connected to the CO2 sensor.

config CO2_SCL_GPIO
    int "GPIO for CO2 sensor SCL"
    default 22
    help
        SCL pin connected to the CO2 sensor.

config CO2_I2C_ADDR
    hex "I2C address of CO2 sensor"
    default 0x61

config LIGHTING_SDA_GPIO
    int "GPIO for lighting driver SDA"
    default 21

config LIGHTING_SCL_GPIO
    int "GPIO for lighting driver SCL"
    default 22

config LIGHTING_I2C_ADDR
    hex "I2C address of lighting controller"
    default 0x40

config LIGHT_SENSOR_ADDR
    hex "I2C address of light sensor"
    default 0x23

config HUMIDITY_PWM_GPIO
    int "GPIO for humidity control PWM"
    default 18
    help
        Pin connected to the humidifier PWM output.

endmenu
```

## components/drivers/Kconfig.projbuild
```kconfig
config DRIVERS_REST_URL
    string "REST endpoint for sensor data"
    default ""
    help
        Base URL for HTTP posts performed by the drivers component.

config DRIVERS_MQTT_URI
    string "MQTT broker URI for sensors"
    default ""
    help
        URI used when connecting to the MQTT broker to publish sensor data.

config DRIVERS_MQTT_TOPIC
    string "MQTT topic for sensor data"
    default ""
    help
        Topic used when publishing sensor measurements.

config LIGHTING_PWM_GPIO
    int "GPIO for lighting PWM"
    default 5
    help
        Pin connected to the lighting PWM output.

config LIGHTING_REST_URL
    string "REST endpoint for lighting state"
    default ""
    help
        URL used when sending lighting state over HTTP.

config LIGHTING_MQTT_TOPIC
    string "MQTT topic for lighting state"
    default ""
    help
        Topic used when publishing lighting state via MQTT.

config LIGHTING_SDA_GPIO
    int "GPIO for lighting driver SDA"
    default 21
    help
        I2C SDA pin used by the lighting controller.

config LIGHTING_SCL_GPIO
    int "GPIO for lighting driver SCL"
    default 22
    help
        I2C SCL pin used by the lighting controller.

config LIGHTING_I2C_ADDR
    hex "I2C address of lighting controller"
    default 0x40
    help
        I2C address used to communicate with the lighting controller.

config CO2_SDA_GPIO
    int "GPIO for CO2 sensor SDA"
    default 21

config CO2_SCL_GPIO
    int "GPIO for CO2 sensor SCL"
    default 22

config CO2_I2C_ADDR
    hex "I2C address of CO2 sensor"
    default 0x61

config CO2_REST_URL
    string "REST endpoint for CO2 measurements"
    default ""
    help
        URL used when posting CO2 data over HTTP.

config CO2_MQTT_TOPIC
    string "MQTT topic for CO2 measurements"
    default ""
    help
        Topic used when publishing CO2 data via MQTT.

config LIGHT_SENSOR_REST_URL
    string "REST endpoint for light sensor measurements"
    default ""
    help
        URL used when posting light sensor data over HTTP.

config LIGHT_SENSOR_MQTT_TOPIC
    string "MQTT topic for light sensor measurements"
    default ""
    help
        Topic used when publishing light sensor data via MQTT.

config LIGHT_SENSOR_ADDR
    hex "I2C address of light sensor"
    default 0x23

config HUMIDITY_REST_URL
    string "REST endpoint for humidity control"
    default ""
    help
        URL used when sending humidity level over HTTP.

config HUMIDITY_MQTT_TOPIC
    string "MQTT topic for humidity control"
    default ""
    help
        Topic used when publishing humidity level via MQTT.

config HUMIDITY_PWM_GPIO
    int "GPIO for humidity control PWM"
    default 18
    help
        Pin connected to the humidifier PWM output.

config LIGHTING_SCHEDULE_REST_URL
    string "REST endpoint for lighting schedule"
    default ""
    help
        URL used when sending lighting schedule over HTTP.

config LIGHTING_SCHEDULE_MQTT_TOPIC
    string "MQTT topic for lighting schedule"
    default ""
    help
        Topic used when publishing lighting schedule via MQTT.
```

## components/storage/Kconfig.projbuild
```kconfig
config STORAGE_TRANSFER_URL
    string "HTTP endpoint for file uploads"
    default ""
    help
        Base URL used when transferring files via Wi-Fi.

config STORAGE_TRANSFER_USERNAME
    string "HTTP authentication username"
    default ""
    help
        Optional username if the server requires authentication.

config STORAGE_TRANSFER_PASSWORD
    string "HTTP authentication password"
    default ""
    help
        Optional password if the server requires authentication.
```

## sdkconfig.defaults
```kconfig
CONFIG_PARTITION_TABLE_CUSTOM=y
CONFIG_PARTITION_TABLE_CUSTOM_FILENAME="partition_table.csv"
CONFIG_PARTITION_TABLE_FILENAME="custom"
CONFIG_DB_DEFAULT_KEY="changeme"
CONFIG_ESPTOOLPY_FLASHSIZE_8MB=y
```
